## conf/distro/raspberrypi.conf
```bitbake
DISTRO = "raspberrypi"
DISTRO_NAME = "Raspberry Pi Distro"
PLATFORM_REV ?= "01"
BUILD_NUMBER ?= "000000"
HOTFIXES ?= "000"
DISTRO_VERSION = "${PLATFORM_REV}.${BUILD_NUMBER}-${HOTFIXES}"
DISTRO_CODENAME = "RPI"

MAINTAINER = "Steven Cai <stevencaiyaohua@gmail.com>"
```

## conf/distro/raspberrypi3.conf
```bitbake
DISTRO = "raspberrypi3"
DISTRO_NAME = "Raspberry Pi Distro"
PLATFORM_REV ?= "01"
BUILD_NUMBER ?= "000000"
HOTFIXES ?= "000"
DISTRO_VERSION = "${PLATFORM_REV}.${BUILD_NUMBER}-${HOTFIXES}"
DISTRO_CODENAME = "RPI"

SDK_VENDOR = '-pokysdk'
SDK_VERSION := "sdk"

MAINTAINER = "Steven Cai <stevencaiyaohua@gmail.com>"

SDK_NAME = "${DISTRO}-${TUNE_PKGARCH}"
SDKPATH = "/opt/${DISTRO}-sdk/${SDK_VERSION}"
```

## conf/layer.conf
```bitbake
# We have a conf and classes directory, add to BBPATH
BBPATH .= ":${LAYERDIR}"

# We have recipes-* directories, add to BBFILES
BBFILES += "${LAYERDIR}/recipes-*/*/*.bb \
            ${LAYERDIR}/recipes-*/*/*.bbappend"

BBFILE_COLLECTIONS += "meta-embedded-platform"
BBFILE_PATTERN_meta-embedded-platform = "^${LAYERDIR}/"
BBFILE_PRIORITY_meta-embedded-platform = "10"

LAYERDEPENDS_meta-embedded-platform = "core"
LAYERSERIES_COMPAT_meta-embedded-platform = "sumo"
```
